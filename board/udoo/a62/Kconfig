## board/udoo/a62/Kconfig
```kconfig
if TARGET_UDOO_A62

config SYS_BOARD
	default "a62"

config SYS_VENDOR
	default "udoo"

config SYS_SOC
	default "mx6"

config SYS_CONFIG_NAME
	default "udoo_a62"

endif
```

## board/udoo/quad_dual/Kconfig
```kconfig
if TARGET_UDOO_QUAD_DUAL

config SYS_VENDOR
	default "udoo"

config SYS_BOARD
	default "quad_dual"

config SYS_CONFIG_NAME
	default "udoo_quad_dual"

endif
```
